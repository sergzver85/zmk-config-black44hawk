## config/boards/arm/black44hawk/Kconfig.board
```kconfig
# Jorian840 board configuration

# Copyright (c) 2022 The ZMK Contributors
# SPDX-License-Identifier: MIT

config BOARD_BLACK44HAWK
	bool "black44hawk"
	depends on SOC_NRF52840_QIAA
```

## config/boards/shields/black44hawk/Kconfig.defconfig
```kconfig
# Copyright (c) 2020 The ZMK Contributors
# SPDX-License-Identifier: MIT

if SHIELD_BLACK44HAWK

config ZMK_KEYBOARD_NAME
    default "BLACK44HAWK"

endif
```

## config/boards/shields/black44hawk/Kconfig.shield
```kconfig
 #
 # Copyright (c) 2020 The ZMK Contributors
 #
 # SPDX-License-Identifier: MIT
 #

config SHIELD_BLACK44HAWK
    def_bool $(shields_list_contains,BLACK44HAWK)
```

## config/west.yml
```yaml
manifest:
  remotes:
    - name: zmkfirmware
      url-base: https://github.com/gtips/reviung/tree/master/reviung41
  projects:
    - name: zmk
      remote: zmkfirmware
      revision: main
      import: app/west.yml
  self:
    path: config
```
